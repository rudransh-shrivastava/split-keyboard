#include "dactyl.dtsi"

/ {
    chosen {
        zmk,kscan = &kscan0;
        zmk,physical-layout = &dactyl_layout;
    };

    kscan0: kscan0 {
        compatible = "zmk,kscan-gpio-matrix";
        diode-direction = "col2row";
        wakeup-source;
        row-gpios
            = <&gpio0 31 (GPIO_ACTIVE_HIGH | GPIO_PULL_DOWN)>
            , <&gpio0 2  (GPIO_ACTIVE_HIGH | GPIO_PULL_DOWN)>
            , <&gpio1 13 (GPIO_ACTIVE_HIGH | GPIO_PULL_DOWN)>
            , <&gpio0 10 (GPIO_ACTIVE_HIGH | GPIO_PULL_DOWN)>
            ;
        col-gpios
            = <&gpio1 6  GPIO_ACTIVE_HIGH>
            , <&gpio1 4  GPIO_ACTIVE_HIGH>
            , <&gpio1 0  GPIO_ACTIVE_HIGH>
            , <&gpio0 22 GPIO_ACTIVE_HIGH>
            , <&gpio0 17 GPIO_ACTIVE_HIGH>
            ;
    };
};
