## boards/shields/dactyl/Kconfig.defconfig
```kconfig
if SHIELD_DACTYL_LEFT || SHIELD_DACTYL_RIGHT

config ZMK_KEYBOARD_NAME
    default "dactyl"

config ZMK_SPLIT
    default y

endif

if SHIELD_DACTYL_LEFT

config ZMK_SPLIT_ROLE_CENTRAL
    default y

endif
```

## boards/shields/dactyl_test/Kconfig.defconfig
```kconfig
if SHIELD_DACTYL_TEST_LEFT || SHIELD_DACTYL_TEST_RIGHT

config ZMK_KEYBOARD_NAME
    default "dactyl_test"

endif
```

## boards/shields/dactyl_test/Kconfig.shield
```kconfig
config SHIELD_DACTYL_TEST_LEFT
    def_bool $(shields_list_contains,dactyl_test_left)

config SHIELD_DACTYL_TEST_RIGHT
    def_bool $(shields_list_contains,dactyl_test_right)
```
